/*
 * Copyright (c) 2026 Ivan Belokobylskiy
 *
 * SPDX-License-Identifier: Apache-2.0
 */

/*
 * MCUboot of the PB-03F (PHY62x2, 512 KiB flash). The boot ROM runs the image at flash 0x2000 through the
 * segment table at its start (zephyr.phy62x2.bin, made by the SoC). The loader's code is XIP at 0x11010100,
 * as the code of a plain application: on the hardware an image XIP below 0x10000 does not start. Two slots
 * of the same size, as on the TB03F: a new image is received in slot 1 (serial recovery on UART0, or the
 * Zigbee OTA client) and swapped into slot 0, which is the one that runs. Keep in step with pb_03f.dts.
 *
 *   0x002000  ROM segment table
 *   0x010000  loader, 0x7f00 (XIP from 0x10100)
 *   0x018000  slot 0, 0x32000 (the MCUboot header 0x200, then the application)
 *   0x04a000  slot 1, 0x32000
 *   0x07c000  storage (the NV of the application)
 */

/ {
	chosen {
		zephyr,uart-mcumgr = &uart0;
		/delete-property/ zephyr,code-partition;
	};
};

&flash0 {
	reg = <0x11010100 0x7f00>;
};
