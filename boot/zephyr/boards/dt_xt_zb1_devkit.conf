## boot/zephyr/boards/pb_03f.conf
```kconfig
CONFIG_BOOT_SIGNATURE_TYPE_NONE=y
# One slot: the application is replaced through the serial recovery
CONFIG_SINGLE_APPLICATION_SLOT=y
CONFIG_BOOT_BOOTSTRAP=n
CONFIG_BOOT_VALIDATE_SLOT0=y

CONFIG_MCUBOOT_SERIAL=y
CONFIG_BOOT_SERIAL_UART=y
CONFIG_BOOT_SERIAL_WAIT_FOR_DFU=y
CONFIG_BOOT_SERIAL_NO_APPLICATION=y
CONFIG_UART_INTERRUPT_DRIVEN=y

CONFIG_FLASH_PAGE_LAYOUT=y
CONFIG_MCUBOOT_LOG_LEVEL_OFF=y
CONFIG_CONSOLE=n
CONFIG_UART_CONSOLE=n
CONFIG_MAIN_STACK_SIZE=1536
CONFIG_PICOLIBC=n
CONFIG_MINIMAL_LIBC=y
```
